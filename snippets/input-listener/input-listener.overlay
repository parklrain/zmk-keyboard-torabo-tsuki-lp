&pointing_listener {
    status = "okay";
    compatible = "zmk,input-listener";
    device = <&pointing_device>;
    input-processors = <&zip_xy_transform (INPUT_TRANSFORM_X_INVERT | INPUT_TRANSFORM_Y_INVERT)>;
    scroller {
        layers = <5>;
        input-processors = <&zip_xy_scaler 1 20>,
                           <&zip_xy_to_scroll_mapper>;
    };
};
